## CMakeLists.txt
```
cmake_minimum_required(VERSION 3.20.0)

if(${BOARD} STREQUAL "thingy91_nrf9160_ns")
message(STATUS "Using static partition definition")
set(PM_STATIC_YML_FILE ${CMAKE_CURRENT_SOURCE_DIR}/thingy91_pm_static.yml)
endif()

find_package(Zephyr REQUIRED HINTS $ENV{ZEPHYR_BASE})
project(application_update)
zephyr_compile_definitions(PROJECT_NAME=${PROJECT_NAME})

# NORDIC SDK APP START
target_sources(app PRIVATE src/main.c)
target_sources(app PRIVATE src/ota/update.c)
target_sources(app PRIVATE src/ota/nce_mender_client.c)
target_sources(app PRIVATE src/ota/led_control.c)
# Include application events and configuration headers
zephyr_library_include_directories(
	src/lib/custom_download_client
	src/lib/custom_fota_download
)

target_include_directories(app PRIVATE src/ota)
target_include_directories(app PRIVATE src/ota/include)
add_subdirectory(src/lib/custom_download_client)
add_subdirectory(src/lib/custom_fota_download)
# NORDIC SDK APP END
```

## Kconfig
```
rsource "src/lib/custom_download_client/Kconfig"
rsource "src/lib/custom_fota_download/Kconfig"

menu "1NCE FOTA Mender demo"

config APPLICATION_VERSION
	int "Mender application version"
	default 1

config ARTIFACT_NAME
	string "Mender articat name"
	default "test"

config USE_HTTPS
	bool
	prompt "Use HTTPS for download"

config COAP_SERVER_HOSTNAME
	string "CoAP server hostname"
	default "coap.os.1nce.com"

config MENDER_URL
	string "Mender server URL"
	default "eu.hosted.mender.io"

config COAP_SERVER_PORT
	int "CoAP server port"
	default 5684 if NCE_DEVICE_AUTHENTICATOR
	default 5683 

config COAP_URI_QUERY
	string "CoAP URI Query"
	help
	   "the URI Query option used to set the MQTT topic for 1NCE IoT integrator"
	default "t=test"

config MENDER_FW_UPDATE_CHECK_FREQUENCY_SECONDS
	int "Firmware Update check Frequency in Seconds"
	default 30

config MENDER_AUTH_CHECK_FREQUENCY_SECONDS
	int "Authentication Status Frequency in Seconds"
	default 15


if NCE_DEVICE_AUTHENTICATOR
config NCE_ENABLE_DTLS
	bool
	default y
config DTLS_SECURITY_TAG
	int "DTLS TAG that will be used to store the received credentials"
	default 1111

config OVERWRITE_CREDENTIALS_IF_EXISTS
	bool "If the DTLS TAG already exists in the modem, it will be overwritten with the new credentials"
	default y
endif

config MENDER_DEVICE_TYPE
	string "Mender device type"
	default "thingy"

config LED_THREAD_STACK_SIZE
	int "LED Thread Stack Size (bytes)"
	default 512
	help
	  Sets the stack size (in bytes) for the LED thread.

choice
	prompt "LED indication"
	default LED_INDICATION_PWM if BOARD_THINGY91_NRF9160_NS
	default LED_INDICATION_GPIO if BOARD_NRF9160DK_NRF9160_NS || $(dt_compat_enabled,gpio-leds)
	default LED_INDICATION_DISABLED

	config LED_INDICATION_PWM
		select LED
		select LED_PWM
		select PWM
		bool "Enable LED indication using the pwm-leds driver"

	config LED_INDICATION_GPIO
		select LED
		select LED_GPIO
		bool "Enable LED indication using the gpio-leds driver"

	config LED_INDICATION_DISABLED
		bool "Disable LED indication"
endchoice

choice
	prompt "LED indication LED type"
	depends on !LED_INDICATION_DISABLED
	default LED_INDICATOR_RGB if BOARD_THINGY91_NRF9160_NS && LED_INDICATION_PWM
	default LED_INDICATOR_4LED if !LED_INDICATION_DISABLED
	default LED_INDICATOR_NONE

	config LED_INDICATOR_RGB
		depends on LED_INDICATION_PWM
		bool "A single RGB LED"

	config LED_INDICATOR_4LED
		depends on !LED_INDICATION_DISABLED
		bool "Four binary LEDs"

	config LED_INDICATOR_NONE
		depends on LED_INDICATION_DISABLED
		bool "No indicator LEDs"

endchoice

config LED_VERBOSE_INDICATION
	depends on !LED_INDICATION_DISABLED
	bool "Enables extra LED status indications"
	default y

config LED_CONTINUOUS_INDICATION
	depends on !LED_INDICATION_DISABLED
	bool "Show an idle pattern instead of turning LEDs off"
	default y

if !NCE_ENERGY_SAVER
config PAYLOAD
	string "Message to send to 1NCE Iot Integrator"
	default "Hi, this is a test message!"
endif

if NCE_ENERGY_SAVER	
config PAYLOAD_DATA_SIZE
	int "payload data size"
	default 10
endif

endmenu

menu "Zephyr Kernel"
source "Kconfig.zephyr"
endmenu
```

## sample.yaml
```
sample:
  name: 1NCE FOTA Mender demo
tests:
  sample.nrf9160.http_update.application_update:
    build_only: true
    integration_platforms:
      - thingy91_nrf9160_ns
      - nrf9160dk_nrf9160_ns
    platform_allow:  thingy91_nrf9160_ns nrf9160dk_nrf9160_ns
    tags: ci_build
```

## prj.conf
```kconfig
# General config
CONFIG_NCS_SAMPLES_DEFAULTS=y
CONFIG_REBOOT=y
CONFIG_NEWLIB_LIBC=y

# Network
CONFIG_NETWORKING=y
CONFIG_NET_SOCKETS=y
CONFIG_NET_NATIVE=n

# LTE link control
CONFIG_LTE_LINK_CONTROL=y
CONFIG_LTE_AUTO_INIT_AND_CONNECT=n

# Modem library
CONFIG_NRF_MODEM_LIB=y
CONFIG_NRF_MODEM_LIB_SYS_INIT=y

# Shell configurations
CONFIG_SHELL=y
CONFIG_SHELL_WILDCARD=n
CONFIG_SHELL_CMD_BUFF_SIZE=128
CONFIG_EVENTS=y

# Flash & NVS
CONFIG_FLASH=y
CONFIG_FLASH_PAGE_LAYOUT=y
CONFIG_NVS=y
CONFIG_MPU_ALLOW_FLASH_WRITE=y

# Library for buttons and LEDs
CONFIG_DK_LIBRARY=y

# Heap and stacks
CONFIG_HEAP_MEM_POOL_SIZE=8048
CONFIG_MAIN_STACK_SIZE=9192
CONFIG_SYSTEM_WORKQUEUE_STACK_SIZE=4048

# Image manager
CONFIG_IMG_MANAGER=y
CONFIG_FLASH=y
CONFIG_IMG_ERASE_PROGRESSIVELY=y

# GPIO
CONFIG_GPIO=y

# FOTA library
CONFIG_CUSTOM_FOTA_DOWNLOAD=y

# Download client
CONFIG_CUSTOM_DOWNLOAD_CLIENT=y
CONFIG_CUSTOM_DOWNLOAD_CLIENT_STACK_SIZE=4096
CONFIG_USE_HTTPS=y
CONFIG_CUSTOM_DOWNLOAD_CLIENT_MAX_FILENAME_SIZE=1000
CONFIG_CUSTOM_DOWNLOAD_CLIENT_HTTP_FRAG_SIZE_1024=y

# DFU Target
CONFIG_DFU_TARGET=y

# Modem key management
CONFIG_MODEM_KEY_MGMT=y
# CONFIG_NRF_MODEM_LIB_TRACE_ENABLED=y
# Application Upgrade support
CONFIG_BOOTLOADER_MCUBOOT=y

# Network Setup
CONFIG_PDN=y
CONFIG_PDN_DEFAULTS_OVERRIDE=y
CONFIG_PDN_DEFAULT_APN="iot.1nce.net"

# # The follwing settings can make the initial network connection faster : 
# # To Specify LTE Bands 
# CONFIG_LTE_LOCK_BANDS=y 
# CONFIG_LTE_LOCK_BAND_MASK="(BANDS)"

# To Choose an operator
# CONFIG_LTE_LOCK_PLMN=y
# CONFIG_LTE_LOCK_PLMN_STRING="(Operator Code)"

# To choose RAT : Cat-M1
CONFIG_LTE_NETWORK_MODE_LTE_M=y
CONFIG_LTE_MODE_PREFERENCE_LTE_M=y

# To choose RAT : NB-IoT 
# CONFIG_LTE_NETWORK_MODE_NBIOT=y
# CONFIG_LTE_MODE_PREFERENCE_NBIOT=y

# AT Host
CONFIG_UART_INTERRUPT_DRIVEN=y
CONFIG_AT_HOST_LIBRARY=y
CONFIG_NRF_MODEM_LIB_TRACE_ENABLED=n
CONFIG_MODEM_INFO=y

# 1NCE SDK
CONFIG_ZEPHYR_NCE_SDK_MODULE=y
CONFIG_NCE_DEVICE_AUTHENTICATOR=y
CONFIG_COAP=y

# Sample configuration
CONFIG_APPLICATION_VERSION=2
CONFIG_ARTIFACT_NAME="release-v2"
CONFIG_MENDER_DEVICE_TYPE="thingy"
CONFIG_MENDER_FW_UPDATE_CHECK_FREQUENCY_SECONDS=30
CONFIG_MENDER_AUTH_CHECK_FREQUENCY_SECONDS=30
CONFIG_MENDER_URL="eu.hosted.mender.io"
CONFIG_COAP_SERVER_HOSTNAME="coap.proxy.os.1nce.com"
CONFIG_COAP_URI_QUERY="mender"
```

## src/main.c
```c
/**
 *
 * @author  Hatim Jamali & Mohamed Abdelmaksoud
 * @date 10 Jan 2024
 * 
 */

#include <zephyr/kernel.h>
#include <zephyr/dfu/mcuboot.h>
#include <zephyr/drivers/gpio.h>
#include <zephyr/sys/reboot.h>
#include <dfu/dfu_target_mcuboot.h>
#include <modem/nrf_modem_lib.h>
#include <custom_fota_download.h>
#include <stdio.h>
#include "update.h"
#include "nce_mender_client.h"
#include "led_control.h"

#define INIT_ATTEMPTS 3

static void fota_dl_handler(const struct fota_download_evt *evt)
{
	switch (evt->id) {
	case CUSTOM_FOTA_DOWNLOAD_EVT_ERROR:
		printk("Received error from fota_download\n");
		if(evt->cause == CUSTOM_FOTA_DOWNLOAD_ERROR_CAUSE_INVALID_UPDATE ){
			printk("Invalid Update\n");
			fota_stop(0);
		}
		else
		{
			printk("Download Error\n");
			fota_stop(1);
		}
		
		break;

	case CUSTOM_FOTA_DOWNLOAD_EVT_FINISHED:

		printk("Firmware Downloaded. Rebooting in 15 seconds to apply new firmware\n");
		fota_done();
		break;

	default:
		break;
	}
}

void main(void)
{
	int err,i=0;

	printk("1NCE FOTA Mender demo started\n");
	long_led_pattern(LED_CONNECTING);
	err = nrf_modem_lib_init(NORMAL_MODE);
	if (err) {
		printk("Failed to initialize modem library!");
		return;
	}
	boot_write_img_confirmed();
	printk("custom_fota_download_init() \n");
	err = custom_fota_download_init(fota_dl_handler);
	if (err != 0) {
		printk("custom_fota_download_init() failed, err %d\n", err);
		return;
	}

	for ( i = 0; i <= INIT_ATTEMPTS; i++)
	{
	err = fota_init(&(struct fota_init_params){
					.update_start = fota_start,
				});
	if (err != 0) {
		printk("fota_init() failed, err %d\n", err);
		long_led_pattern(LED_FAILURE);
		return;
	} else {
		break;	
	} 

	}
	

}
```
